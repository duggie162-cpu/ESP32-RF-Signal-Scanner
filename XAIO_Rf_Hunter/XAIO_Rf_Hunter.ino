#include <Arduino.h>
#include <Wire.h>
#include <Adafruit_GFX.h>
#include <Adafruit_SSD1306.h>
#include <math.h>

/*
Wiring Guide for RF Signal Scanner:

Power Circuit:
1. Boost Converter A OUT+ (adjusted to 9V) -> AD8317 VCC
2. Boost Converter B OUT+ (adjusted to 5V) -> XAIO VCC In

Signal and Control:
7. AD8317 VOUT -> D0 (GPIO2) - ADC capable
8. Potentiometer VCC -> XAIO 3.3V
9. Potentiometer GND -> XAIO GND
10. Potentiometer Wiper -> D1 (GPIO3) - ADC capable
11. OLED Display VCC -> XAIO 3.3V
12. OLED Display GND -> XAIO GND
13. OLED Display SDA -> D4 (GPIO21)
14. OLED Display SCL -> D5 (GPIO20)
15. Piezo Buzzer positive -> D8 (GPIO8) - digital output
16. Piezo Buzzer negative -> XAIO GND

Notes:
- The power switch controls the main Ground flow from the battery.
- u103 potentiometer pinout 3.3v - D1 - Ground

*/

#define SCREEN_WIDTH 128 // OLED display width, in pixels
#define SCREEN_HEIGHT 64 // OLED display height, in pixels

// Pin definitions for ESP32
#define RF_SENSOR_PIN 2     // D0 (GPIO2) - ADC capable
#define POT_PIN 3           // D1 (GPIO3) - ADC capable
#define OLED_SDA 6         // D4 (GPIO21)
#define OLED_SCL 7         // D5 (GPIO20)
#define BUZZER_PIN 8        // D8 (GPIO8) - digital output

Adafruit_SSD1306 display(SCREEN_WIDTH, SCREEN_HEIGHT, &Wire, -1);

/* -------- Boot Logo Bitmap -------- */
#define LOGO_WIDTH  128
#define LOGO_HEIGHT 64

// 'logo black white', 128x64px
const unsigned char epd_bitmap_logo_black_white [] PROGMEM = {
	0x00, 0x00, 0x00, 0x00, 0x00, 0x00, 0x00, 0x00, 0x00, 0x00, 0x00, 0x00, 0x00, 0x00, 0x00, 0x00, 
	0x00, 0x00, 0x00, 0x00, 0x00, 0x00, 0x00, 0x00, 0x00, 0x00, 0x00, 0x00, 0x00, 0x00, 0x00, 0x00, 
	0x00, 0x00, 0x00, 0x00, 0x00, 0x00, 0x00, 0x00, 0x00, 0x00, 0x00, 0x00, 0x00, 0x00, 0x00, 0x00, 
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	0x00, 0x00, 0x00, 0x00, 0x00, 0x00, 0x00, 0x00, 0x00, 0x00, 0x00, 0x00, 0x00, 0x00, 0x00, 0x00
};

// Array of all bitmaps for convenience. (Total bytes used to store images in PROGMEM = 1040)
const int epd_bitmap_allArray_LEN = 1;
const unsigned char* epd_bitmap_allArray[1] = {
	epd_bitmap_logo_black_white
};

const int numReadings = 20;
int readings[numReadings];
int readIndex = 0;
long total = 0;

int baselineRaw = 0;
int minRaw = 4095;  // ESP32 ADC is 12-bit (0-4095)
int maxRaw = 0;

float rawToVoltage(int raw) {
  return raw * (3.3f / 4095.0f);  // ESP32 ADC is 12-bit
}

int getBaselineRange() {
  int potValue = analogRead(POT_PIN);
  // Map potentiometer value to 0-200 range
  return map(potValue, 0, 4095, 0, 200);
}

// AD8317 specific constants
const float V_MIN = 0.33f;  // Minimum output voltage
const float V_MAX = 1.65f;  // Maximum output voltage
const float SLOPE = -22.0f; // mV/dB
const float INTERCEPT = 0.0f; // dBm at V_MAX (adjusted)

float voltageTodBm(float voltage) {
  if (voltage < V_MIN) return -70.0f;
  if (voltage > V_MAX) return 0.0f;
  return SLOPE * (voltage - V_MAX) + INTERCEPT;
}

void showBootLogo() {
  display.clearDisplay();
  int x = (SCREEN_WIDTH  - LOGO_WIDTH)  / 2;
  int y = (SCREEN_HEIGHT - LOGO_HEIGHT) / 2;

  display.drawBitmap(
    x, y,
    epd_bitmap_logo_black_white,
    LOGO_WIDTH, LOGO_HEIGHT,
    SSD1306_WHITE
  );

  display.display();
  delay(4000);  // show logo for 4 seconds
}

void setup() {
  Serial.begin(115200);
  delay(1000);
  Serial.println(F("\n\nRF Signal Scanner - ESP32 with AD8317"));

  // Initialize I2C communication for the display
  Wire.begin(OLED_SDA, OLED_SCL);

  // Try to initialize the display multiple times if needed
  bool displayInitialized = false;
  for (int attempt = 0; attempt < 3 && !displayInitialized; attempt++) {
    if (display.begin(SSD1306_SWITCHCAPVCC, 0x3C)) {
      displayInitialized = true;
    } else {
      Serial.println(F("SSD1306 allocation failed, retrying..."));
      // Perform a soft reset by reinitializing I2C
      Wire.end();
      delay(100);
      Wire.begin(OLED_SDA, OLED_SCL);
      delay(100);
    }
  }

  if (!displayInitialized) {
    Serial.println(F("SSD1306 allocation failed after multiple attempts"));
    // You can decide to continue or halt the program here
  } else {
    showBootLogo();
    display.clearDisplay();
    display.setTextSize(1);
    display.setTextColor(SSD1306_WHITE);

    // Display initialization success message
    display.setCursor(0, 0);
    display.println(F("TURN OFF ALL DEVICES"));
    display.display();
    delay(2500);
  }

  pinMode(RF_SENSOR_PIN, INPUT);
  pinMode(POT_PIN, INPUT);
  pinMode(BUZZER_PIN, OUTPUT);

  // Establish baseline
  long sum = 0;
  for (int i = 0; i < 100; i++) {
    sum += analogRead(RF_SENSOR_PIN);
    delay(10);
  }
  baselineRaw = sum / 100;
  minRaw = maxRaw = baselineRaw;

  Serial.print(F("Baseline Raw: "));
  Serial.println(baselineRaw);

  display.clearDisplay();
  display.setCursor(0, 0);
  display.println(F("RF Signal Scanner"));
  display.setCursor(0, 16);
  display.print(F("Baseline: "));
  display.println(baselineRaw);
  display.display();
  delay(2000);

  for (int i = 0; i < numReadings; i++) {
    readings[i] = baselineRaw;
  }
  total = baselineRaw * numReadings;

  Serial.println(F("Setup complete"));
}


void loop() {
  int baselineRange = getBaselineRange();

  total = total - readings[readIndex];
  readings[readIndex] = analogRead(RF_SENSOR_PIN);
  total = total + readings[readIndex];
  readIndex = (readIndex + 1) % numReadings;

  int average = total / numReadings;

  if (average < minRaw) minRaw = average;
  if (average > maxRaw) maxRaw = average;

  float voltage = rawToVoltage(average);
  float dBm = voltageTodBm(voltage);
  int signalStrength = 0;
  if (baselineRange > 0) {
    signalStrength = map(average, baselineRaw, baselineRaw + baselineRange, 0, 10);
    signalStrength = constrain(signalStrength, 0, 10);
  }

  Serial.print(F("Raw: "));
  Serial.print(average);
  Serial.print(F(" Range: "));
  Serial.print(baselineRange);
  Serial.print(F(" V: "));
  Serial.print(voltage, 3);
  Serial.print(F("V dBm: "));
  Serial.print(dBm, 1);
  Serial.print(F(" Strength: "));
  Serial.println(signalStrength);

  display.clearDisplay();

  // Title
  display.setTextSize(1);
  display.setCursor(0, 0);
  display.println(F("RF Signal Strength"));

  // Raw value and voltage
  display.setCursor(0, 16);
  display.print(F("Raw: "));
  display.print(average);
  display.setCursor(64, 16);
  display.print(F("V: "));
  display.print(voltage, 2);
  display.print(F("V"));

  // Range and dBm
  display.setCursor(0, 26);
  display.print(F("Range: "));
  display.print(baselineRange);
  display.setCursor(64, 26);
  display.print(F("dBm: "));
  display.print(dBm, 1);

  // Signal strength
  display.setCursor(0, 36);
  display.print(F("Strength: "));
  display.print(signalStrength);

  // Draw signal strength bars
  int barWidth = 12;
  int barSpacing = 2;
  int startX = (SCREEN_WIDTH - (barWidth * 10 + barSpacing * 9)) / 2;
  int barMaxHeight = 20;

  for (int i = 0; i < 10; i++) {
    int barHeight = (i < signalStrength) ? map(i, 0, 9, 5, barMaxHeight) : 2;
    display.fillRect(startX + i * (barWidth + barSpacing), SCREEN_HEIGHT - barHeight, barWidth, barHeight, SSD1306_WHITE);
  }

  display.display();

  // Beep based on signal strength
  if (signalStrength > 0) {
    int freq = map(signalStrength, 1, 10, 500, 2000);
    tone(BUZZER_PIN, freq, 50);
  }

  delay(100);
}
